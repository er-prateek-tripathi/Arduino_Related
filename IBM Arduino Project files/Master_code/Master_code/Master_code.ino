
//Dht11 and led

#include <Adafruit_Sensor.h>
 #include <DHT.h> 
int length = 1;
 #define DHTPIN 9
#define DHTTYPE DHT11
 #define LED_TOO_COLD A1
 #define LED_PERFECT A2
#define LED_TOO_HOT A3
DHT dht(DHTPIN, DHTTYPE); 
   
 //Moisture sensor

int sensorPin = A4; 
int const sensorValue = 0;

//water level , piezo and servo
#include <Servo.h> 
#include<SoftwareSerial.h>
//Ultrasonic with piezo

// Define pins for ultrasonic and buzzer int const trigPin = 4;
 int const echoPin = 3; 
int const buzzPin = 11;
int const trigPin = 4 ;

//PIR + Piezo

int inputPin = 2; // The input pin of the PIR sensor
int pirState = LOW; // initially, we assume that there is no motion detected
int val = 0; // variable for reading the pin status
int pinSpeaker = 10; // The buzzer on PWM pin 10


void setup()
 { //dht11
    Serial.begin(9600); 
    Serial.println("DHT11 test!"); 
    dht.begin(); 
    
//rain detector with piezo
   //on pin5 we have the rain sensor so this is an input 
pinMode(5, INPUT); 
//on pin 12 we have buzzer so this is an output 
pinMode(12, OUTPUT); 

//water level , piezo and servo
int servoPin = 6; 
// Create a servo object 

Servo Servo1;
int level; 
const int analog_0=0; 
int l1=7; 

int l2=8;
Servo1.attach(servoPin); 

//pir and piezo

pinMode(inputPin, INPUT); // declare sensor as input
pinMode(pinSpeaker, OUTPUT);
Serial.begin(9600);

//Ultrasonic and piezo


pinMode(trigPin, OUTPUT); // trig pin will have pulses output 
pinMode(echoPin, INPUT); // echo pin should be input to get pulse width pinMode(buzzPin, OUTPUT); // buzz pin is output to control buzzering


    } 
void loop() 
{ //dht11
    pinMode (A1, OUTPUT); 
    pinMode (A2 , OUTPUT);
     pinMode (A3 , OUTPUT); 
    delay(2000); 
    float h = dht.readHumidity();
     float t = dht.readTemperature();
     float f = dht.readTemperature(true);
     if (isnan(h) || isnan(t) || isnan(f)) 
 { 
Serial.println("Failed to read from DHT sensor!");
 return; 
 } 
    Serial.print("Humidity: ");
     Serial.print(h);
     Serial.print(" %\t");
     Serial.print("Temperature: ");
     Serial.print(t); 
    Serial.println(" *C "); 
    if (t <= 20) 
        { 
        Serial.println("Too cold!"); 
        digitalWrite(A1, HIGH);
        delay (1000);
        digitalWrite(A1, LOW);
         } 
    if (20 < t < 27)
     { 
Serial.println("Perfect temperature!"); 
        digitalWrite(A2, HIGH);
        delay (2000); 
        digitalWrite(A2, LOW); 
      } 
if (t >= 32)
  { 
   Serial.println("Too hot!"); 
        digitalWrite(A3, HIGH); 
        
        delay (1000); 
         
        digitalWrite(A3, LOW); 
        }
     }
//Rain detector with Piezo
//when rain sensor gives LOW signal it means that it rains 
if(digitalRead(5) == LOW)
{ 
//for half a second we turn the buzzer on 

digitalWrite(12, HIGH); 
delay(500);
 //for half a second we turn the buzzer off 

digitalWrite(12, LOW); 
delay(500); 
//so we have the beep-beep signal like an alarm
 } 
 else
 {
   digitalWrite(12,LOW);
 }
//moisture sensor

 sensorValue= analogRead(sensorPin); 
 Serial.println("Analog Value : ");
 Serial.println(sensorValue);
    delay(1500);
//water level , piezo and servo
level=analogRead(analog_0); Serial.println(level); if(level>500&&level<550)
 { 
//No water
digitalWrite(l1, HIGH); 
digitalWrite(l2, LOW); 
// Make servo go to 0 degrees 
   
    Servo1.write(0); 
  
     delay(300); 
   // Make servo go to 90 degrees 
 
 Servo1.write(45); 
  
   delay(300); 
   // Make servo go to 180 degrees 
 
      Servo1.write(180); 
  
     delay(5000);
}
 else if(level>600&&level<620)
 { //Little water
digitalWrite(l1, LOW);
 digitalWrite(l2,LOW);
// Make servo go to 0 degrees 
   
    Servo1.write(0); 
  
     delay(300); 
   // Make servo go to 90 degrees 
 
 Servo1.write(45); 
  
   delay(300); 
   // Make servo go to 180 degrees 
 
      Servo1.write(180); 
  
     delay(5000);
} 
else if(level>620&&level<630) 
{ 
digitalWrite(l1, LOW);
 digitalWrite(l2, LOW);
// Make servo go to 0 degrees 
   
    Servo1.write(0); 
  
     delay(300); 
   // Make servo go to 90 degrees 
 
 Servo1.write(45); 
  
   delay(300);
 } 
else if(level>630&&level<650) 
{
 digitalWrite(l1, LOW);
digitalWrite(l2, HIGH); 
digitalWrite(13, HIGH); 
delay(300);
digitalWrite(13,LOW);
delay(300);
}
//ultrasonic with piezo

// Duration will be the input pulse width and distance will be the distance to the obstacle in centimeters
 int duration, distance;
 // Output pulse with 1ms width on trigPin digitalWrite(trigPin, HIGH); 
delay(1); 
digitalWrite(trigPin, LOW);
 // Measure the pulse input in echo pin duration = pulseIn(echoPin, HIGH);
 // Distance is half the duration devided by 29.1 (from datasheet) 
distance = (duration/2) / 29.1; 
// if distance less than 0.5 meter and more than 0 (0 or less means over range)
 if (distance <= 50 && distance >= 0)
 { 
// Buzz 
digitalWrite(buzzPin, HIGH); 
} 
else
 { 
// Don't buzz 
digitalWrite(buzzPin, LOW); 
} 
// Waiting 60 ms won't hurt any one delay(6
delay(60);
}
//pir with Piezo
  
val = digitalRead(inputPin); // reads the input value
if (val == HIGH) { // checks if the input is HIGH
playTone(300, 160);
delay(150);
if (pirState == LOW) {
// we have just turned on
Serial.println("Motion detected!");
// We only want to print on the output change, not state
pirState = HIGH;
}
}
else {
playTone(0, 0);
delay(300);
if (pirState == HIGH){
// we have just turned of
Serial.println("Motion ended!");
// We only want to print on the output change, not state
pirState = LOW;
}
}
}
// duration in mSecs, frequency in hertz
void playTone(long duration, int freq) {
duration *= 1000;
int period = (1.0 / freq) * 1000000;
long elapsed_time = 0;
while (elapsed_time < duration) {
digitalWrite(pinSpeaker,HIGH);
delayMicroseconds(period / 2);
digitalWrite(pinSpeaker, LOW);
delayMicroseconds(period / 2);
elapsed_time +=(period);
}

}